## buildroot/Config.in
```kconfig
source "$BR2_EXTERNAL_REMOTEOS_PATH/package/remoteos/Config.in"
source "$BR2_EXTERNAL_REMOTEOS_PATH/package/remoteos-fonts/Config.in"
source "$BR2_EXTERNAL_REMOTEOS_PATH/package/remoteos-broadcom-sta/Config.in"
```

## buildroot/configs/hp2140_defconfig
```kconfig
BR2_i386=y
BR2_x86_atom=y
BR2_TOOLCHAIN_BUILDROOT_GLIBC=y
BR2_GCC_VERSION_14_X=y
BR2_TOOLCHAIN_BUILDROOT_CXX=y
BR2_PACKAGE_BUSYBOX_SHOW_OTHERS=y
BR2_PACKAGE_BUSYBOX_CONFIG_FRAGMENT_FILES="$(BR2_EXTERNAL_REMOTEOS_PATH)/board/hp2140/busybox.fragment"
BR2_KERNEL_HEADERS_AS_KERNEL=y
BR2_REPRODUCIBLE=y
BR2_GLOBAL_PATCH_DIR="$(BR2_EXTERNAL_REMOTEOS_PATH)/patches/packages"
BR2_TARGET_GENERIC_HOSTNAME="remoteos"
BR2_TARGET_GENERIC_ISSUE="RemoteOS HP2140 diagnostic - hardware qualification pending"
BR2_INIT_BUSYBOX=y
BR2_ROOTFS_DEVICE_CREATION_DYNAMIC_EUDEV=y
# BR2_TARGET_ENABLE_ROOT_LOGIN is not set
# BR2_TARGET_GENERIC_GETTY is not set
# BR2_TARGET_GENERIC_REMOUNT_ROOTFS_RW is not set
BR2_ROOTFS_USERS_TABLES="$(BR2_EXTERNAL_REMOTEOS_PATH)/board/hp2140/users.txt"
BR2_ROOTFS_OVERLAY="$(BR2_EXTERNAL_REMOTEOS_PATH)/board/hp2140/overlay"
BR2_ROOTFS_POST_BUILD_SCRIPT="$(BR2_EXTERNAL_REMOTEOS_PATH)/board/hp2140/post-build.sh"
BR2_ROOTFS_POST_IMAGE_SCRIPT="$(BR2_EXTERNAL_REMOTEOS_PATH)/board/hp2140/post-image.sh"
BR2_LINUX_KERNEL=y
BR2_LINUX_KERNEL_USE_CUSTOM_CONFIG=y
BR2_LINUX_KERNEL_CUSTOM_CONFIG_FILE="$(BR2_EXTERNAL_REMOTEOS_PATH)/board/hp2140/linux.config"
BR2_LINUX_KERNEL_INSTALL_TARGET=y
BR2_LINUX_KERNEL_NEEDS_HOST_OPENSSL=y
BR2_LINUX_KERNEL_NEEDS_HOST_LIBELF=y
BR2_PACKAGE_CA_CERTIFICATES=y
BR2_PACKAGE_OPENSSL=y
BR2_PACKAGE_LIBOPENSSL_BIN=y
BR2_PACKAGE_DBUS=y
BR2_PACKAGE_DBUS_GLIB=y
BR2_PACKAGE_LIBCURL=y
BR2_PACKAGE_LIBCURL_CURL=y
BR2_PACKAGE_IPROUTE2=y
BR2_PACKAGE_IPTABLES=y
BR2_PACKAGE_IW=y
BR2_PACKAGE_WIRELESS_REGDB=y
BR2_PACKAGE_WPA_SUPPLICANT=y
BR2_PACKAGE_WPA_SUPPLICANT_NL80211=y
BR2_PACKAGE_WPA_SUPPLICANT_WEXT=y
BR2_PACKAGE_WPA_SUPPLICANT_DEBUG_SYSLOG=y
BR2_PACKAGE_WPA_SUPPLICANT_CLI=y
BR2_PACKAGE_WPA_SUPPLICANT_PASSPHRASE=y
BR2_PACKAGE_TAILSCALE=y
BR2_PACKAGE_OPENRESOLV=y
BR2_PACKAGE_B43_FIRMWARE=y
BR2_PACKAGE_B43_FIRMWARE_KERNEL_AFTER_3_2=y
BR2_PACKAGE_LINUX_FIRMWARE=y
BR2_PACKAGE_LINUX_FIRMWARE_BRCM_BCM43XX=y
BR2_PACKAGE_LINUX_FIRMWARE_BRCM_BCM43XXX=y
BR2_PACKAGE_PCIUTILS=y
BR2_PACKAGE_USBUTILS=y
BR2_PACKAGE_USBIP=y
BR2_PACKAGE_KMOD=y
BR2_PACKAGE_KMOD_TOOLS=y
BR2_PACKAGE_LIBV4L=y
BR2_PACKAGE_LIBV4L_UTILS=y
BR2_PACKAGE_ALSA_UTILS=y
BR2_PACKAGE_ALSA_UTILS_AMIXER=y
BR2_PACKAGE_ALSA_UTILS_APLAY=y
BR2_PACKAGE_IPERF3=y
BR2_PACKAGE_UTIL_LINUX=y
BR2_PACKAGE_UTIL_LINUX_BINARIES=y
BR2_PACKAGE_UTIL_LINUX_LIBBLKID=y
BR2_PACKAGE_UTIL_LINUX_MOUNT=y
BR2_PACKAGE_E2FSPROGS=y
BR2_PACKAGE_E2FSPROGS_FSCK=y
BR2_PACKAGE_XORG7=y
BR2_PACKAGE_XSERVER_XORG_SERVER=y
BR2_PACKAGE_XSERVER_XORG_SERVER_MODULAR=y
BR2_PACKAGE_XDRIVER_XF86_VIDEO_INTEL=y
BR2_PACKAGE_XDRIVER_XF86_INPUT_EVDEV=y
BR2_PACKAGE_XDRIVER_XF86_INPUT_LIBINPUT=y
BR2_PACKAGE_XKEYBOARD_CONFIG=y
BR2_PACKAGE_XAPP_XINIT=y
BR2_PACKAGE_XAPP_XINPUT=y
BR2_PACKAGE_XAPP_XAUTH=y
BR2_PACKAGE_XAPP_XRANDR=y
BR2_PACKAGE_XAPP_XVINFO=y
BR2_PACKAGE_XAPP_XSET=y
BR2_PACKAGE_XAPP_XDPYINFO=y
BR2_PACKAGE_LIBGTK3=y
BR2_PACKAGE_ADWAITA_ICON_THEME=y
BR2_PACKAGE_HICOLOR_ICON_THEME=y
BR2_PACKAGE_SHARED_MIME_INFO=y
BR2_PACKAGE_LIBGTK3_X11=y
BR2_PACKAGE_MESA3D=y
BR2_PACKAGE_MESA3D_GALLIUM_DRIVER_I915=y
BR2_PACKAGE_MESA3D_GALLIUM_DRIVER_SWRAST=y
BR2_PACKAGE_MESA3D_OPENGL_GLX=y
BR2_PACKAGE_MESA3D_OPENGL_EGL=y
BR2_PACKAGE_MESA3D_OPENGL_ES=y
BR2_PACKAGE_LIBERATION=y
BR2_PACKAGE_LIBERATION_SANS=y
BR2_PACKAGE_WEBKITGTK=y
BR2_PACKAGE_WEBKITGTK_X11=y
BR2_PACKAGE_WEBKITGTK_SANDBOX=y
BR2_PACKAGE_WEBKITGTK_HTTPS=y
BR2_PACKAGE_WEBKITGTK_MINIBROWSER=y
BR2_PACKAGE_GSTREAMER1=y
BR2_PACKAGE_GSTREAMER1_INSTALL_TOOLS=y
BR2_PACKAGE_GST1_PLUGINS_BASE=y
BR2_PACKAGE_GST1_PLUGINS_BASE_PLUGIN_APP=y
BR2_PACKAGE_GST1_PLUGINS_BASE_PLUGIN_AUDIOCONVERT=y
BR2_PACKAGE_GST1_PLUGINS_BASE_PLUGIN_AUDIORESAMPLE=y
BR2_PACKAGE_GST1_PLUGINS_BASE_PLUGIN_ALSA=y
BR2_PACKAGE_GST1_PLUGINS_BASE_PLUGIN_OPUS=y
BR2_PACKAGE_GST1_PLUGINS_BASE_PLUGIN_VOLUME=y
BR2_PACKAGE_GST1_PLUGINS_BASE_PLUGIN_VIDEOCONVERTSCALE=y
BR2_PACKAGE_GST1_PLUGINS_BASE_PLUGIN_VIDEOTESTSRC=y
BR2_PACKAGE_GST1_PLUGINS_BASE_PLUGIN_AUDIOTESTSRC=y
BR2_PACKAGE_GST1_PLUGINS_BASE_PLUGIN_PLAYBACK=y
BR2_PACKAGE_GST1_PLUGINS_GOOD=y
BR2_PACKAGE_GST1_PLUGINS_GOOD_PLUGIN_RTP=y
BR2_PACKAGE_GST1_PLUGINS_GOOD_PLUGIN_RTPMANAGER=y
BR2_PACKAGE_GST1_PLUGINS_GOOD_PLUGIN_UDP=y
BR2_PACKAGE_GST1_PLUGINS_GOOD_PLUGIN_V4L2=y
BR2_PACKAGE_GST1_PLUGINS_BAD=y
BR2_PACKAGE_GST1_PLUGINS_BAD_PLUGIN_VIDEOPARSERS=y
BR2_PACKAGE_GST1_PLUGINS_BAD_PLUGIN_DTLS=y
BR2_PACKAGE_GST1_PLUGINS_BAD_PLUGIN_SRTP=y
BR2_PACKAGE_GST1_LIBAV=y
# BR2_PACKAGE_FFMPEG_FFMPEG is not set
BR2_PACKAGE_FFMPEG_ENCODERS="mpeg2video"
BR2_PACKAGE_FFMPEG_DECODERS="mpeg2video"
BR2_PACKAGE_FFMPEG_MUXERS=""
BR2_PACKAGE_FFMPEG_DEMUXERS=""
BR2_PACKAGE_FFMPEG_PARSERS="mpegvideo"
BR2_PACKAGE_FFMPEG_BSFS=""
BR2_PACKAGE_FFMPEG_PROTOCOLS=""
BR2_PACKAGE_FFMPEG_FILTERS=""
# BR2_PACKAGE_FFMPEG_INDEVS is not set
# BR2_PACKAGE_FFMPEG_OUTDEVS is not set
BR2_PACKAGE_REMOTEOS=y
BR2_PACKAGE_REMOTEOS_FONTS=y
BR2_TARGET_ROOTFS_SQUASHFS=y
BR2_TARGET_ROOTFS_SQUASHFS4_GZIP=y
# BR2_TARGET_ROOTFS_TAR is not set
BR2_TARGET_GRUB2=y
BR2_TARGET_GRUB2_I386_PC=y
BR2_TARGET_GRUB2_INSTALL_TOOLS=y
BR2_PACKAGE_HOST_GENIMAGE=y
BR2_PACKAGE_HOST_E2FSPROGS=y
```

## buildroot/package/remoteos-broadcom-sta/Config.in
```kconfig
config BR2_PACKAGE_REMOTEOS_BROADCOM_STA
	bool "RemoteOS BCM4322 proprietary wl diagnostic"
	depends on BR2_i386
	depends on BR2_LINUX_KERNEL
	depends on BR2_INIT_BUSYBOX
	depends on BR2_ROOTFS_DEVICE_CREATION_DYNAMIC_EUDEV
	depends on !BR2_STATIC_LIBS
	select BR2_PACKAGE_BUSYBOX_SHOW_OTHERS
	select BR2_PACKAGE_KMOD
	select BR2_PACKAGE_KMOD_TOOLS
	help
	  Optional Broadcom STA 6.30.223.271 with Debian revision 32
	  compatibility patches, for the HP 2140 BCM4322 (14e4:432b).
	  Requires the qualified 32-bit Linux 6.12.109 configuration.

	  Contains a proprietary binary; see the package README and retained
	  Broadcom license before distributing an image. The wrapper is built
	  against the image kernel. No kernel security policy is disabled.

	  Use hp2140_wl_defconfig for a wl diagnostic boot choice and a b43
	  recovery choice. Without an explicit wl boot argument, wl is blocked.

	  https://sources.debian.org/src/broadcom-sta/6.30.223.271-32/
```

## buildroot/package/remoteos-fonts/Config.in
```kconfig
config BR2_PACKAGE_REMOTEOS_FONTS
	bool "RemoteOS IBM Plex Sans fonts"
	help
	  IBM Plex Sans regular and semibold from the upstream 6.4.0 release.
```

## buildroot/package/remoteos/Config.in
```kconfig
config BR2_PACKAGE_REMOTEOS
	bool "remoteos"
	depends on BR2_INSTALL_LIBSTDCPP
	depends on BR2_TOOLCHAIN_GCC_AT_LEAST_8
	depends on BR2_PACKAGE_LIBGTK3
	depends on BR2_PACKAGE_GSTREAMER1
	depends on BR2_PACKAGE_WEBKITGTK
	select BR2_PACKAGE_OPENSSL
	help
	  RemoteOS client shell, diagnostic tools and host protocol programs.
```
